/*
*	==========================================================================
*   OV7670_control.c	
*   (c) 2014, Petr Machala
*
*   Description:
*   OV7670 camera configuration and control file.
*   Optimized for 32F429IDISCOVERY board.
*
*   This program is free software: you can redistribute it and/or modify
*   it under the terms of the GNU General Public License as published by
*   the Free Software Foundation, either version 3 of the License, or
*   any later version.
*   
*   This program is distributed in the hope that it will be useful,
*   but WITHOUT ANY WARRANTY; without even the implied warranty of
*   MERCHANTABILITY or FITNESS FOR A PARTICULAR PURPOSE.  See the
*   GNU General Public License for more details.
*  
*   You should have received a copy of the GNU General Public License
*   along with this program.  If not, see <http://www.gnu.org/licenses/>.
*
*   Camera wiring:
*   3V3		-	3V		;		GND		-	GND
*   SIOC	-	PB8		;		SIOD	-	PB9
*   VSYNC -	PB7		;		HREF	-	PA4
*   PCLK	-	PA6		;		XCLK	-	PA8
*   D7		-	PE6		;		D6		-	PE5
*   D5		-	PB6		;		D4		-	PE4
*   D3		-	PC9		;		D2		-	PC8
*   D1		-	PC7		;		D0		-	PC6
*   RESET	-	/			;		PWDN	-	/
*		
*	==========================================================================
*/

#include "headers.h"
#include "ov7670.h"
// Image buffer
volatile uint16_t FrameBuffer[IMG_ROWS*IMG_COLUMNS];



const uint8_t OV7670ConfigRegisters [OV7670_REG_NUM][2] = 
{				
	{0x12, 0x80},		//Reset registers
	
	// Image format
	{0x12, 0x14},		//QVGA size, RGB mode
	{0x40, 0xd0},		//RGB565
	{0xb0, 0x84},		//Color mode
	
	// Hardware window
	{0x11, 0x01},		//PCLK settings, 15fps
	{0x32, 0x80},		//HREF
	{0x17, 0x17},		//HSTART
	{0x18, 0x05},		//HSTOP
	{0x03, 0x0a},		//VREF
	{0x19, 0x02},		//VSTART
	{0x1a, 0x7a},		//VSTOP
	
	// Scalling numbers
	{0x70, 0x3a},		//X_SCALING
	{0x71, 0x35},		//Y_SCALING
	{0x72, 0x11},		//DCW_SCALING
	{0x73, 0xf0},		//PCLK_DIV_SCALING
	{0xa2, 0x02},		//PCLK_DELAY_SCALING
	
	// Matrix coefficients
	{0x4f, 0x80},		{0x50, 0x80},
	{0x51, 0x00},		{0x52, 0x22},
	{0x53, 0x5e},		{0x54, 0x80},
	{0x58, 0x9e},
	
	// Gamma curve values
	{0x7a, 0x20},		{0x7b, 0x10},
	{0x7c, 0x1e},		{0x7d, 0x35},
	{0x7e, 0x5a},		{0x7f, 0x69},
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	{0x88, 0xd7},		{0x89, 0xe8},
	
	// AGC and AEC parameters
	{0xa5, 0x05},		{0xab, 0x07},
	{0x24, 0x95},		{0x25, 0x33},
	{0x26, 0xe3},		{0x9f, 0x78},
	{0xa0, 0x68},		{0xa1, 0x03},
	{0xa6, 0xd8},		{0xa7, 0xd8},
	{0xa8, 0xf0},		{0xa9, 0x90},
	{0xaa, 0x94},		{0x10, 0x00},
	
	// AWB parameters
	{0x43, 0x0a},		{0x44, 0xf0},
	{0x45, 0x34},		{0x46, 0x58},
	{0x47, 0x28},		{0x48, 0x3a},
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	{0x02, 0x60},		{0x13, 0xe7},
	
	// Additional parameters
	{0x34, 0x11},		{0x3f, 0x00},
	{0x75, 0x05},		{0x76, 0xe1},
	{0x4c, 0x00},		{0x77, 0x01},
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	{0x4b, 0x01}
};

void Delay(volatile uint32_t nCount)
{
  while(nCount--){	
  }
}

bool OV7670WriteRegister(uint8_t Address, uint8_t* Data)
{
  uint8_t I2CBuffer[2];
  typeI2CError Error = I2C_NO_ERR;
  
  
  I2CBuffer[0] = Address;
  I2CBuffer[1] = Data[0];
  
  Error |= I2CWrite(CAMERA_I2C_PORT, OV7670_I2C_ADDR, I2CBuffer, 2);
  
  if(Error != I2C_NO_ERR) return true;
  
  return false;
  
  
  /*if(HAL_I2C_Master_Transmit(&hi2c1,OV7670_I2C_ADDR,I2CBuffer,2,0xffff) == HAL_OK)  
    return false;
  else 
    return true;*/
}

bool OV7670Init(void)
{
	uint8_t Data, i = 0;
	bool Error;

	// Configure camera registers
	for(i = 0; i < OV7670_REG_NUM; i++)
  {
		Data = OV7670ConfigRegisters[i][1]; 
		Error = OV7670WriteRegister(OV7670ConfigRegisters[i][0], &Data);
		if (Error == true) break;
			
		LCD_ILI9341_DrawLine(99+i, 110, 99+i, 130, ILI9341_COLOR_WHITE);
		Delay(0xFFFF);
	}	
	return Error;
}

